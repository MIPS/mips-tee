## ree/Config.in
```kconfig
menu "MIPS-TEE packages"
source "$BR2_EXTERNAL_MIPS_REE_PATH/package/libteec/Config.in"
source "$BR2_EXTERNAL_MIPS_REE_PATH/package/mips-tee-test/xtest/Config.in"

if BR2_PACKAGE_LIBTEEC
menu "Client applications"
source "$BR2_EXTERNAL_MIPS_REE_PATH/package/mips-tee-test/clientapps/Config.in"
endmenu
endif

endmenu
```

## ree/board/linux_mipstee_defconfig
```kconfig
CONFIG_MIPS_VIRT=y
CONFIG_PAGE_SIZE_16KB=y
CONFIG_BLK_DEV_INITRD=y
CONFIG_DEVTMPFS=y
CONFIG_DEVTMPFS_MOUNT=y
CONFIG_BLK_DEV_RAM=y
# CONFIG_KEYBOARD_ATKBD is not set
# CONFIG_MOUSE_PS2 is not set
# CONFIG_SERIO is not set
CONFIG_VIRTIO_CONSOLE=y
CONFIG_VIRTIO_MMIO=y
CONFIG_TEE=y
CONFIG_MIPSTEE=y
CONFIG_EXT4_FS=y
CONFIG_EXT4_FS_POSIX_ACL=y
CONFIG_EXT4_FS_SECURITY=y
```

## ree/configs/mips_tee_defconfig
```kconfig
BR2_mipsel=y
BR2_mips_32r5=y
# BR2_MIPS_SOFT_FLOAT is not set
BR2_PACKAGE_OVERRIDE_FILE="../override.mk"
BR2_TOOLCHAIN_EXTERNAL=y
BR2_TOOLCHAIN_EXTERNAL_PREINSTALLED=y
BR2_TOOLCHAIN_EXTERNAL_PATH="/<path_to_external>/toolchains/mips-mti-linux-gnu/2016.05-06"
BR2_PACKAGE_HOST_GDB=y
BR2_ROOTFS_OVERLAY="../board/rootfs_overlay"
BR2_ROOTFS_POST_BUILD_SCRIPT="$(BR2_EXTERNAL_MIPS_REE_PATH)/board/post_build.sh"
BR2_ROOTFS_POST_IMAGE_SCRIPT="$(BR2_EXTERNAL_MIPS_REE_PATH)/board/post_image.sh"
BR2_LINUX_KERNEL=y
BR2_LINUX_KERNEL_CUSTOM_VERSION=y
BR2_LINUX_KERNEL_CUSTOM_VERSION_VALUE="4.4"
BR2_LINUX_KERNEL_USE_CUSTOM_CONFIG=y
BR2_LINUX_KERNEL_CUSTOM_CONFIG_FILE="$(BR2_EXTERNAL_MIPS_REE_PATH)/board/linux_mipstee_defconfig"
BR2_LINUX_KERNEL_VMLINUX=y
BR2_PACKAGE_BUSYBOX_CONFIG="$(BR2_EXTERNAL_MIPS_REE_PATH)/board/busybox.config"
BR2_PACKAGE_STRACE=y
BR2_PACKAGE_OPENSSL=y
BR2_PACKAGE_NCURSES=y
BR2_TARGET_ROOTFS_CPIO=y
BR2_TARGET_ROOTFS_TAR_GZIP=y
BR2_PACKAGE_LIBTEEC=y
BR2_PACKAGE_XTEST=y
```
